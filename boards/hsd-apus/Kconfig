## boards/hsd-apus/Kconfig
```kconfig
# SPDX-FileCopyrightText: 2026 Jakob Jungreuthmayer
# SPDX-License-Identifier: LGPL-2.1-only

config BOARD
    default "hsd-apus" if BOARD_HSD_APUS

config BOARD_HSD_APUS
    bool
    default y
    select CPU_MODEL_STM32F072VB

    # Clock configuration
    select BOARD_HAS_HSE

source "$(RIOTBOARD)/common/stm32/Kconfig"
```
